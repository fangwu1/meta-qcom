## conf/machine/maili-mtp.conf
```bitbake
#@TYPE: Machine
#@NAME: SM8950 Kit
#@DESCRIPTION: Machine configuration for Qualcomm SM8950

require conf/machine/include/qcom-sm8950.inc

MACHINE_FEATURES += "efi pci tpm2"

KERNEL_DEVICETREE ?= " \
                      qcom/maili-mtp.dtb \
                      "
QCOM_DTB_DEFAULT ?= "maili-mtp"
FIT_DTB_COMPATIBLE[maili-mtp] = "qcom,maili-mtp"

MACHINE_ESSENTIAL_EXTRA_RRECOMMENDS += " \
    packagegroup-maili-mtp-firmware \
    packagegroup-maili-mtp-hexagon-dsp-binaries \
"

# Bootloader configuration
ABL_SIGNATURE_VERSION ?= "v7"

# Partition configuration
QCOM_PARTITION_FILES_SUBDIR ?= "partitions/maili-mtp/ufs"
```
