## conf/machine/qcs615-adp-air-emmc.conf
```bitbake
#@TYPE: Machine
#@NAME: Qualcomm QCS615 ADP Air (eMMC)
#@DESCRIPTION: Machine configuration for QCS615 ADP Air with eMMC storage.

require conf/machine/qcs615-adp-air.conf

QCOM_PARTITION_FILES_SUBDIR = "partitions/qcs615-adp-air/emmc"
```
